## CMakeLists.txt
```
cmake_minimum_required(VERSION 3.13.1)

set(CMAKE_CXX_STANDARD 11)
set(CMAKE_CXX_STANDARD_REQUIRED ON)

set(spm_CONF_FILE
    prj.conf
    ${CMAKE_CURRENT_LIST_DIR}/boards/spm.conf
)

find_package(Zephyr REQUIRED HINTS $ENV{ZEPHYR_BASE})

project(example-standalone-inferencing-zephyr)

zephyr_include_directories(config)

include(utils/cmake/utils.cmake)
# Needed for colorful output
zephyr_compile_options(-fdiagnostics-color=always)

# Use hardware acceleration for DSP and Neural Network code
# You'll need to disable these on non-Arm cores
add_definitions(-DEIDSP_USE_CMSIS_DSP=1
                -DEIDSP_LOAD_CMSIS_DSP_SOURCES=1
                -DEI_CLASSIFIER_TFLITE_ENABLE_CMSIS_NN=1
                -DEIDSP_QUANTIZE_FILTERBANK=0
                -DARM_MATH_LOOPUNROLL
                -DEI_SENSOR_AQ_STREAM=FILE
                )

# Edge impulse SDK include directories
set(INCLUDES
    .
    src
    tflite-model
    model-parameters
    edge-impulse-sdk
    edge-impulse-sdk/third_party/ruy
    edge-impulse-sdk/third_party/gemmlowp
    edge-impulse-sdk/third_party/flatbuffers/include
    edge-impulse-sdk/third_party
    edge-impulse-sdk/tensorflow
    edge-impulse-sdk/dsp
    edge-impulse-sdk/classifier
    edge-impulse-sdk/anomaly
    edge-impulse-sdk/CMSIS/NN/Include
    edge-impulse-sdk/CMSIS/DSP/PrivateInclude
    edge-impulse-sdk/CMSIS/DSP/Include
    edge-impulse-sdk/CMSIS/Core/Include
    edge-impulse/ingestion-sdk-c
    edge-impulse/ingestion-sdk-platform/NordicSemi-nrf91
    edge-impulse/ingestion-sdk-platform/NordicSemi-nrf91/sensors
    edge-impulse/mbedtls_hmac_sha256_sw
    edge-impulse/QCBOR/inc
    edge-impulse/QCBOR/src
    edge-impulse/repl
    edge-impulse-sdk/porting
    )
include_directories(${INCLUDES})

#file(GLOB PLATFORM "${CMAKE_CURRENT_LIST_DIR}/ingestion-sdk-platform/eta-compute/*.cpp")
#file(GLOB REPL "${CMAKE_CURRENT_LIST_DIR}/repl/*.cpp")
#file(GLOB INGESTION "${CMAKE_CURRENT_LIST_DIR}/ingestion-sdk-c/*.cpp")
#file(GLOB QCBOR "${CMAKE_CURRENT_LIST_DIR}/QCBOR/src/*.c")
#file(GLOB MBEDTLS "${CMAKE_CURRENT_LIST_DIR}/mbedtls_hmac_sha256_sw/mbedtls/src/*.c")
#file(GLOB EIPORT "${CMAKE_CURRENT_LIST_DIR}/edge-impulse-sdk/porting/YOURTARGET/*.cpp")

RECURSIVE_FIND_FILE(SOURCE_FILES "edge-impulse-sdk" "*.cpp")
RECURSIVE_FIND_FILE(MODEL_FILES "tflite-model" "*.cpp")
RECURSIVE_FIND_FILE(CC_FILES "edge-impulse-sdk" "*.cc")
RECURSIVE_FIND_FILE(S_FILES "edge-impulse-sdk" "*.s")
RECURSIVE_FIND_FILE(C_FILES "edge-impulse-sdk" "*.c")

RECURSIVE_FIND_FILE(PLATFORM_FILES "edge-impulse/ingestion-sdk-platform/NordicSemi-nrf91" "*.cpp")
RECURSIVE_FIND_FILE(PLATFORM_C_FILES "edge-impulse/ingestion-sdk-platform/NordicSemi-nrf91" "*.c")
RECURSIVE_FIND_FILE(REPL_FILES "edge-impulse/repl" "*.cpp")
RECURSIVE_FIND_FILE(INGESTION_FILES "edge-impulse/ingestion-sdk-c/" "*.cpp")
RECURSIVE_FIND_FILE(QCBOR_FILES "edge-impulse/QCBOR/src" "*.c")
RECURSIVE_FIND_FILE(MBEDTLS_FILES "edge-impulse/mbedtls_hmac_sha256_sw/mbedtls/src" "*.c")
RECURSIVE_FIND_FILE(PORTING_FILES "edge-impulse-sdk/porting/zephyr" "*.cpp")

list(APPEND SOURCE_FILES ${S_FILES})
list(APPEND SOURCE_FILES ${C_FILES})
list(APPEND SOURCE_FILES ${CC_FILES})
list(APPEND SOURCE_FILES ${MODEL_FILES})

list(APPEND SOURCE_FILES ${PLATFORM_FILES})
list(APPEND SOURCE_FILES ${PLATFORM_C_FILES})
list(APPEND SOURCE_FILES ${REPL_FILES})
list(APPEND SOURCE_FILES ${INGESTION_FILES})
list(APPEND SOURCE_FILES ${QCBOR_FILES})
list(APPEND SOURCE_FILES ${MBEDTLS_FILES})
list(APPEND SOURCE_FILES ${PORTING_FILES})

# add all sources to the project
target_sources(app PRIVATE ${SOURCE_FILES})
target_sources(app PRIVATE src/main.cpp)
```

## Kconfig
```
#
# Copyright (c) 2020 Nordic Semiconductor ASA
#
# SPDX-License-Identifier: LicenseRef-Nordic-5-Clause
#

menu "MQTT Edge Impulse Demo"
config MQTT_PUB_TOPIC_PREFIX
	string "MQTT publish topic"
	default "safecility/alarm"

config MQTT_BROKER_HOSTNAME
	string "MQTT broker hostname"
	default "broker.hivemq.com"

config MQTT_BROKER_PORT
	int "MQTT broker port"
	default 1883

config MQTT_RECONNECT_DELAY_S
	int "Seconds to delay before attempting to reconnect to the broker."
	default 60

config LTE_CONNECT_RETRY_DELAY_S
	int "Seconds to delay before attempting to retry LTE connection."
	default 120

endmenu

menu "Zephyr Kernel"
source "Kconfig.zephyr"
endmenu

module = MQTT_EI_DEMO
module-str = MQTT Edge Impulse Demo
source "${ZEPHYR_BASE}/subsys/logging/Kconfig.template.log_config"
```

## prj.conf
```kconfig
# GPIO settings
CONFIG_GPIO=y

# Enable c++ support
CONFIG_CPLUSPLUS=y

CONFIG_LIB_CPLUSPLUS=y
CONFIG_NEWLIB_LIBC=y
CONFIG_NEWLIB_LIBC_FLOAT_PRINTF=y

# Enable reboot from user space
CONFIG_REBOOT=y

CONFIG_FPU=y
CONFIG_MAIN_STACK_SIZE=8192

# Serial console
CONFIG_SERIAL=y
CONFIG_UART_INTERRUPT_DRIVEN=y
CONFIG_CONSOLE_SUBSYS=n
CONFIG_CONSOLE_GETCHAR=n

# i2c configuration for accelerometer
CONFIG_I2C=y
CONFIG_I2C_NRFX=y

# enable PDM driver
CONFIG_NRFX_PDM=y

# Assertions
CONFIG_ASSERT=y

# Logging
CONFIG_DEBUG=y
CONFIG_LOG=y
CONFIG_LTE_LINK_CONTROL_LOG_LEVEL_DBG=y
CONFIG_LTE_LINK_CONTROL_LOG_LEVEL=4
CONFIG_FATAL_ERROR_LOG_LEVEL_DBG=y
CONFIG_FATAL_ERROR_LOG_LEVEL=4

# External Flash memory
CONFIG_FLASH=y
CONFIG_FLASH_PAGE_LAYOUT=y
CONFIG_MPU_ALLOW_FLASH_WRITE=y
CONFIG_NORDIC_QSPI_NOR=y
CONFIG_NORDIC_QSPI_NOR_FLASH_LAYOUT_PAGE_SIZE=4096
```

## prj_nrf9160dk_nrf9160ns.conf
```kconfig
# GPIO Settings
CONFIG_GPIO=y

# Enable c++ support
CONFIG_CPLUSPLUS=y
CONFIG_LIB_CPLUSPLUS=y
CONFIG_NEWLIB_LIBC=y
CONFIG_NEWLIB_LIBC_FLOAT_PRINTF=y

# Enable reboot from user space
CONFIG_REBOOT=y

# Peripheral settings
CONFIG_FPU=y

# Stack & Heap size
CONFIG_MAIN_STACK_SIZE=8192

# Serial console
CONFIG_SERIAL=y
CONFIG_UART_INTERRUPT_DRIVEN=y
CONFIG_CONSOLE_SUBSYS=n
CONFIG_CONSOLE_GETCHAR=n

# i2c configuration for accelerometer
CONFIG_I2C=y
CONFIG_I2C_NRFX=y

# GPIO expander for controlling LEDs
CONFIG_GPIO_PCAL6408A=y

# Enable PDM driver
CONFIG_NRFX_PDM=y

# Logging settings
CONFIG_ASSERT=y
CONFIG_DEBUG=y
CONFIG_LOG=y

# External Flash memory
CONFIG_FLASH=y
CONFIG_FLASH_PAGE_LAYOUT=y
CONFIG_MPU_ALLOW_FLASH_WRITE=y
CONFIG_SPI=y
CONFIG_SPI_NOR=y
CONFIG_SPI_NOR_FLASH_LAYOUT_PAGE_SIZE=4096
CONFIG_SPI_NOR_SFDP_DEVICETREE=y

# Modem info
CONFIG_HEAP_MEM_POOL_SIZE=4096

# Logging
CONFIG_ASSERT=y
CONFIG_DEBUG=y
CONFIG_LOG=y

# Networking
CONFIG_NETWORKING=y
CONFIG_NET_SOCKETS=y
CONFIG_MODEM_INFO=y
CONFIG_NET_NATIVE=n
CONFIG_NET_SOCKETS_OFFLOAD=y
CONFIG_NET_SOCKETS_POSIX_NAMES=y

# LTE link control
CONFIG_LTE_LINK_CONTROL=y
CONFIG_LTE_AUTO_INIT_AND_CONNECT=n

# Modem library
CONFIG_NRF_MODEM_LIB=y

# Enable PDN management
CONFIG_PDN=y
CONFIG_PDN_SYS_INIT=y
CONFIG_PDN_DEFAULTS_OVERRIDE=y
CONFIG_PDN_LEGACY_PCO=y
CONFIG_PDN_DEFAULT_APN="arkessalp.com"
CONFIG_PDN_DEFAULT_AUTH_PAP=y
CONFIG_PDN_DEFAULT_USERNAME="arkessa"
CONFIG_PDN_DEFAULT_PASSWORD="arkessa"

# Set network type
CONFIG_LTE_NETWORK_MODE_NBIOT_GPS=y
CONFIG_LTE_NETWORK_USE_FALLBACK=n

# AT Host
CONFIG_AT_CMD=y
CONFIG_AT_NOTIF=y
# CONFIG_AT_CMD_SYS_INIT=y
# CONFIG_AT_HOST_LIBRARY=y

# MQTT
CONFIG_MQTT_LIB=y
CONFIG_MQTT_LIB_TLS=n
CONFIG_MQTT_CLEAN_SESSION=y

CONFIG_NRF_MODEM_LIB_SYS_INIT=n
# CONFIG_MODEM_KEY_MGMT=y
```

## src/main.cpp
```c
#include <zephyr.h>
//#include "ei_run_classifier.h"
#include "numpy.hpp"

#include <sys/printk.h>
#include "ei_device_nordic_nrf91.h"
#include "ei_zephyr_flash_commands.h"
#include "ei_main.h"

int main(void)
{
    /* This is needed so that output of printf 
       is output immediately without buffering 
    */
    setvbuf(stdout, NULL, _IONBF, 0);

    /* Initialize board uart */
    if(uart_init() != 0){
        ei_printf("Init uart on board error occured\r\n");
    }

    /** Initialize development board LEDs */
    if(BOARD_ledInit() != 0){
        ei_printf("Init LEDs on board error occured\r\n");
    }

    /* Initialize Zephyr flash device */
    create_flash_device();

    /* Initialize Edge Impulse sensors and commands */
    ei_init();

    /* Connect to network */
    
    while(1){
        ei_main();
    }
}
```
